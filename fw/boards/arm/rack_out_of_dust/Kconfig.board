## fw/boards/arm/rack_out_of_dust/Kconfig.board
```kconfig
# Copyright (c) 2024 Nordic Semiconductor ASA
# SPDX-License-Identifier: Apache-2.0

config BOARD_RACK_OUT_OF_DUST
	bool "rack_out_of_dust"
	depends on SOC_NRF52840_QIAA
```

## fw/boards/arm/rack_out_of_dust/Kconfig.defconfig
```kconfig
# Copyright (c) 2024 Nordic Semiconductor ASA
# SPDX-License-Identifier: Apache-2.0

if BOARD_RACK_OUT_OF_DUST

config BOARD
	default "rack_out_of_dust"

config BT_CTLR
   default BT


endif
```
